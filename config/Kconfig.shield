## config/Kconfig.shield
```kconfig
config SHIELD_KOD_04_LEFT
    def_bool $(shields_list_contains,kod_04_left)

config SHIELD_KOD_04_RIGHT
    def_bool $(shields_list_contains,kod_04_right)
```

## config/boards/shields/kod_04_right/kconfig.defconfig
```kconfig
if SHIELD_KOD_04_LEFT

config ZMK_KEYBOARD_NAME
    default "Kod-04"

config ZMK_SPLIT_ROLE_CENTRAL
    default n

endif

if SHIELD_KOD_04_RIGHT

config ZMK_KEYBOARD_NAME
    default "Kod-04"

config ZMK_SPLIT_ROLE_CENTRAL
    default y

endif

if SHIELD_KOD_04_LEFT || SHIELD_KOD_04_RIGHT

config ZMK_SPLIT
    default y

endif
```
