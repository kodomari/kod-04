## config/west.yml
```yaml
manifest:
  remotes:
    - name: zmkfirmware
      url-base: https://github.com/zmkfirmware
    - name: yourgithub
      url-base: https://github.com/kodomari
    - name: prospector
      url-base: https://github.com/t-ogura
  projects:
    - name: zmk
      remote: zmkfirmware
      revision: main
      import: app/west.yml
    - name: kb_zmk_ps2_mouse_trackpoint_driver
      remote: yourgithub
      revision: fix-zephyr41
      path: modules/kb_zmk_ps2_mouse_trackpoint_driver
    - name: prospector-zmk-module
      remote: prospector
      revision: v2.1.0
      path: modules/prospector-zmk-module
  self:
    path: config
    
```

## modules/led_status/Kconfig
```kconfig
config ZMK_LED_STATUS
    bool "BLE status LED indicator"
    default y
    depends on ZMK_BLE
```
